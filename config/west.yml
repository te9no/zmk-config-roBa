## config/west.yml
```yaml
manifest:
  remotes:
    - name: zmkfirmware
      url-base: https://github.com/zmkfirmware
    - name: kumamuk-git
      url-base: https://github.com/kumamuk-git
    - name: urob
      url-base: https://github.com/urob
    - name: te9no
      url-base: https://github.com/te9no
  projects:
    - name: zmk
      remote: urob
      revision: 
      import: app/west.yml
    - name: zmk-pmw3610-driver
      remote: kumamuk-git
      revision: 
    - name: zmk-leader-key
      remote: urob
      revision: 
  self:
    path: config
```
